## conf/layer.conf
```bitbake
# We have a conf and classes directory, add to BBPATH
BBPATH .= ":${LAYERDIR}"

# We have a recipes-* directories, add to BBFILES
BBFILES += " \
	${LAYERDIR}/recipes-*/*/*.bb \
	${LAYERDIR}/recipes-*/*/*.bbappend \
"

BBFILE_COLLECTIONS += "jetson-tk1"
BBFILE_PATTERN_jetson-tk1 = "^${LAYERDIR}/"
BBFILE_PRIORITY_jetson-tk1 = "6"
```

## conf/machine/jetson-tk1-l4t.conf
```bitbake
#@TYPE: Machine
#@NAME: NVidia Jetson TK1
#@DESCRIPTION: NVidia Jetson TK1 board

require conf/machine/include/tune-cortexa15.inc
# set up SOC
SOC_FAMILY = "tegra"

require conf/machine/include/soc-family.inc

OLDEST_KERNEL = "2.6.32"
DEFAULTTUNE = "cortexa15hf-neon"

PREFERRED_PROVIDER_virtual/xserver ?= "xserver-xorg"
PREFERRED_PROVIDER_virtual/kernel ?= "linux-L4T"
PREFERRED_PROVIDER_virtual/mesa ?= "mesa"
PREFERRED_PROVIDER_virtual/libgl ?= "mesa"

SERIAL_CONSOLE = "115200 ttyS0"

XSERVER ?= "xserver-xorg \
            mesa-driver-swrast \
            xf86-input-evdev \
            xf86-input-mouse \
            xf86-video-fbdev \
            xf86-input-keyboard \
            linux-driver-package \
            linux-driver-package-firmware \
            "

KERNEL_IMAGETYPE = "zImage"
MACHINE_EXTRA_RRECOMMENDS += "bootconfig kernel-image kernel-devicetree"
```

## conf/machine/jetson-tk1.conf
```bitbake
#@TYPE: Machine
#@NAME: NVidia Jetson TK1
#@DESCRIPTION: NVidia Jetson TK1 board

require conf/machine/include/tune-cortexa15.inc

OLDEST_KERNEL = "3.16.0"
DEFAULTTUNE = "cortexa15hf-neon"

PREFERRED_PROVIDER_virtual/xserver ?= "xserver-xorg"
PREFERRED_PROVIDER_virtual/kernel ?= "linux-upstream"
PREFERRED_PROVIDER_virtual/mesa ?= "mesa"
PREFERRED_PROVIDER_virtual/libgl ?= "mesa"

SERIAL_CONSOLE = "115200 ttyS0"

XSERVER ?= "xserver-xorg \
            xserver-xorg-extension-glx \
            mesa-driver-swrast \
            xf86-input-evdev \
            xf86-input-mouse \
            xf86-video-fbdev \
            xf86-input-keyboard"
```
